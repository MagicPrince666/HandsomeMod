## package/boot/uboot-sunxi/src/configs/LicheePi_Zero_defconfig
```kconfig
CONFIG_ARM=y
CONFIG_ARCH_SUNXI=y
CONFIG_SPL=y
CONFIG_MACH_SUN8I_V3S=y
CONFIG_DRAM_CLK=360
CONFIG_VIDEO_LCD_DCLK_PHASE=0
CONFIG_DEFAULT_DEVICE_TREE="sun8i-v3s-licheepi-zero"
CONFIG_DM_REGULATOR=y
CONFIG_DM_PWM=y
CONFIG_PWM_SUNXI=y
# CONFIG_NETDEVICES is not set
CONFIG_BOOTDELAY=1
CONFIG_SYS_PROMPT="Prince> "

CONFIG_VIDEO_LCD_MODE="x:800,y:480,depth:18,pclk_khz:30000,le:16,ri:209,up:22,lo:22,hs:30,vs:1,sync:0,vmode:0"
CONFIG_BOOTCOMMAND="setenv lcd_bl_pin 134; run distro_bootcmd;"
```

## package/boot/uboot-sunxi/src/configs/orangepi_pc2_spinand_defconfig
```kconfig
CONFIG_ARM=y
CONFIG_ARCH_SUNXI=y
CONFIG_SPL=y
CONFIG_MACH_SUN50I_H5=y
CONFIG_DRAM_CLK=672
CONFIG_DRAM_ZQ=3881977
# CONFIG_DRAM_ODT_EN is not set
CONFIG_MACPWR="PD6"
CONFIG_MMC0_CD_PIN="PF6"
# CONFIG_SYS_MALLOC_CLEAR_ON_INIT is not set
CONFIG_DEFAULT_DEVICE_TREE="sun50i-h5-orangepi-pc2"
CONFIG_SUN8I_EMAC=y
CONFIG_USB_EHCI_HCD=y
CONFIG_USB_OHCI_HCD=y
CONFIG_USB_MUSB_GADGET=y
CONFIG_BOOTDELAY=0
CONFIG_SYS_PROMPT="Prince> "
CONFIG_CONS_INDEX=1

# CONFIG_NETDEVICES is not set
CONFIG_DM_ETH=y
CONFIG_MII=y
CONFIG_DM_MDIO_MUX=y
CONFIG_MTD_UBI=y
CONFIG_MTD_UBI_FASTMAP=y
CONFIG_MTD_UBI_FASTMAP_AUTOCONVERT=y
CONFIG_CMD_UBI=y
CONFIG_CMD_UBIFS=y
CONFIG_RBTREE=y
CONFIG_MTD_DEVICE=y
CONFIG_MTD_PARTITIONS=y
CONFIG_CMD_MTDPARTS=y
CONFIG_LZO=y
CONFIG_LZMA=y
CONFIG_ENV_IS_IN_FAT=n
CONFIG_ENV_IS_IN_UBI=y
CONFIG_ENV_UBI_PART="ubi0"
CONFIG_ENV_UBI_VOLUME="ubootenv"
CONFIG_ENV_UBI_VOLUME_REDUND="ubootenv2"
CONFIG_MTDIDS_DEFAULT="spi-nand0=0"
CONFIG_MTDPARTS_DEFAULT="mtdparts=0:1M(boot),-(ubi0)"
CONFIG_BOOTCOMMAND="ubifsmount ubi0:kernel; ubifsload $kernel_addr_r Image; ubifsload $fdt_addr_r dtb; booti $kernel_addr_r - $fdt_addr_r"
CONFIG_USE_BOOTARGS=y
CONFIG_BOOTARGS="console=ttyS0,115200 earlyprintk earlycon=uart,mmio32,0x01c28000 rootwait ubi.mtd=1,2048 rootfstype=ubifs root=ubi0:rootfs rw"

# CONFIG_SPI_BOOT is not set
# CONFIG_SPL_SPI_SUPPORT is not set
# CONFIG_SPL_SPI_SUNXI is not set
CONFIG_CLK=y
CONFIG_CLK_SUNXI=y
CONFIG_SUNXI_SPI=y
CONFIG_SPI_SUNXI=y
CONFIG_MTD=y
CONFIG_DM_MTD=y
CONFIG_MTD_SPI_NAND=y
CONFIG_CMD_MTD=y
CONFIG_SPI=y
CONFIG_SPI_MEM=y
CONFIG_SPL_SPINAND_SUNXI=y
CONFIG_DM=y
CONFIG_DM_SPI=y
CONFIG_CMD_DM=y
CONFIG_CMD_SPI=y
CONFIG_SPL_SPINAND_SUNXI_SPL_USE_GENERIC2K_ON_UNKNOWN=y
```

## package/prince/kmod-esp32/src/Kconfig
```kconfig
config ESP32_SDIO
	tristate "Espressif ESP32 SDIO WiFi"
	depends on MAC80211
	select BT
	select BT_HCIUART
	---help---
	  ESP32 is a low-budget 2.4GHz WiFi chip by Espressif, used in many
	  cheap tablets with Allwinner or Rockchip SoC

config SUPPORT_ESP_SERIAL
	bool "Enable serial support for ESP32"
	depends on ESP32_SDIO
	default y
	---help---
	  serial process support for ESP32

config ENABLE_MONITOR_PROCESS
	bool "Enable monitor process support for ESP32"
	depends on ESP32_SDIO
	default n
	---help---
	  monitor process support for ESP32
```
